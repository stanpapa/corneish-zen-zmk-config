## config/west.yml
```yaml
manifest:
  defaults:
    revision: main
  remotes:
    - name: zmkfirmware
      url-base: https://github.com/zmkfirmware
    - name: SethMilliken
      url-base: https://github.com/SethMilliken
  projects:
    - name: zmk
      remote: SethMilliken
      revision: zen-display-patches
      import: app/west.yml
  self:
    path: config
```
